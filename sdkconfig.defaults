## sdkconfig.defaults
```kconfig
# Target: Seeed XIAO ESP32S3
CONFIG_IDF_TARGET="esp32s3"

# Flash size: 8MB (XIAO ESP32S3)
CONFIG_ESPTOOLPY_FLASHSIZE_8MB=y
CONFIG_ESPTOOLPY_FLASHSIZE="8MB"

# PSRAM (XIAO ESP32S3 has 8MB PSRAM)
CONFIG_ESP32S3_SPIRAM_SUPPORT=y
CONFIG_SPIRAM=y
CONFIG_SPIRAM_MODE_OCT=y
```
